## host-kernel/kbuild/Kconfig
```kconfig
# SPDX-License-Identifier: GPL-2.0

menu "McKernel native Rust host modules"
	depends on RUST
	depends on X86_64

config MCKERNEL_IHK_RUST
	tristate "McKernel IHK core host module (Rust)"
	help
	  Build the native Rust-for-Linux IHK provider module.  This module
	  contains no project-owned C implementation objects.

config MCKERNEL_IHK_SMP_X86_64_RUST
	tristate "McKernel IHK x86_64 SMP host module (Rust)"
	depends on MCKERNEL_IHK_RUST
	help
	  Build the native Rust-for-Linux x86_64 SMP consumer module.  The
	  module consumes the versioned IHK provider namespace.

config MCKERNEL_MCCTRL_RUST
	tristate "McKernel control host module (Rust)"
	depends on MCKERNEL_IHK_RUST
	help
	  Build the native Rust-for-Linux McKernel control consumer module.
	  The module consumes the versioned IHK provider namespace.

endmenu
```

## host-kernel/native-rust/Kconfig
```kconfig
menu "McKernel native Rust host modules"

depends on RUST

config MCKERNEL_RUST_IHK
	tristate "Native Rust IHK core host module"
	help
	  Build the project-owned ihk host module as a native Rust-for-Linux
	  module. This production target must not link any project C object.

config MCKERNEL_RUST_IHK_SMP_X86_64
	tristate "Native Rust IHK SMP x86_64 host module"
	depends on X86_64 && MCKERNEL_RUST_IHK
	help
	  Build the project-owned x86_64 SMP host module as native Rust.

config MCKERNEL_RUST_MCCTRL
	tristate "Native Rust McKernel control module"
	depends on MCKERNEL_RUST_IHK
	help
	  Build mcctrl as a native Rust-for-Linux module. The legacy C module and
	  manually compiled Rust helper object are reference-only for this target.

endmenu
```
